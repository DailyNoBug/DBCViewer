VERSION "1.0"

NS_ :

BS_:

BU_: Vector__XXX

BO_ 2000 ExampleMessage: 8 Vector__XXX
 SG_ ExampleSignal : 0|8@1+ (1,0) [0|255] "units" Vector__XXX

CM_ BO_ 2000 "Example message for testing";
CM_ SG_ 2000 ExampleSignal "Example signal within the message";

BA_DEF_ BO_ "GenMsgCycleTime" INT 0 65535;
BA_DEF_DEF_ "GenMsgCycleTime" 100;

VAL_ 2000 ExampleSignal 0 "Value0" 1 "Value1" 2 "Value2";
